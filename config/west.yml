## config/west.yml
```yaml
manifest:
  remotes:
    - name: zmkfirmware
      url-base: https://github.com/zmkfirmware
    - name: ftc-zmk
      url-base: https://github.com/ftc
  projects:
    - name: zmk
      remote: zmkfirmware
      revision: ae8299e
      import: app/west.yml
  self:
    path: config
```
